## boot/hpmicro_loader/Config.in
```kconfig
config BR2_TARGET_HPMICRO_LOADER
	bool "hpmicro_opensbi_loader"
	help
	  Lowlevel loader for hpmciro SOCs using OpenSBI

if BR2_TARGET_HPMICRO_LOADER
config BR2_TARGET_HPMICRO_BOARD_NAME
	string "HPMicro Board Name"
	help
	  Enter HPMicro Board Name. Example: hpm6800evk. This is passed to hpm_sdk's cmake arg "-DBOARD={}":"https://github.com/hpmicro/hpm_sdk"
endif
```

## boot/rustsbi-hpm/Config.in
```kconfig
config BR2_TARGET_RUSTSBI_HPM
	bool "rustsbi-hpm"
	depends on BR2_riscv
	help
	  RustSBI implement for HPMicro MCUs.

	  https://github.com/rustsbi/rustsbi-hpm.git
```

## configs/hpmicro_hpm6800evk_defconfig
```kconfig
BR2_riscv=y
BR2_riscv_custom=y

BR2_RISCV_ISA_RVI=y
BR2_RISCV_ISA_RVM=y
BR2_RISCV_ISA_RVA=y
BR2_RISCV_ISA_RVC=y
BR2_RISCV_32=y
BR2_RISCV_ABI_ILP32=y
BR2_BINFMT_FLAT=y
# BR2_RISCV_USE_MMU is not set
BR2_KERNEL_HEADERS_VERSION=y
BR2_DEFAULT_KERNEL_VERSION="6.10"
BR2_TOOLCHAIN_BUILDROOT_USE_SSP=y
BR2_ENABLE_LTO=y
BR2_ROOTFS_MERGED_USR=y
BR2_TARGET_GENERIC_GETTY_PORT="hvc0"
# BR2_TARGET_GENERIC_REMOUNT_ROOTFS_RW is not set
BR2_ROOTFS_POST_IMAGE_SCRIPT="support/scripts/genimage.sh"
BR2_ROOTFS_POST_IMAGE_SCRIPT_ARGS="-c board/hpmicro/hpm6800evk/genimage_opensbi.cfg"
BR2_LINUX_KERNEL=y
BR2_LINUX_KERNEL_CUSTOM_TARBALL=y
BR2_LINUX_KERNEL_CUSTOM_TARBALL_LOCATION="$(call github,xuzihan351,linux,e9ce608a570b788a66d0b39359005285985d6f71)/linux-e9ce608a570b788a66d0b39359005285985d6f71.tar.gz"
BR2_LINUX_KERNEL_DEFCONFIG="nommu_hpmicro"
BR2_LINUX_KERNEL_DTS_SUPPORT=y
BR2_LINUX_KERNEL_INTREE_DTS_NAME="hpmicro/hpm6800-evk"
BR2_PACKAGE_BUSYBOX_CONFIG="board/hpmicro/hpm6800evk/busybox.config"
# BR2_PACKAGE_IFUPDOWN_SCRIPTS is not set
BR2_TARGET_ROOTFS_SQUASHFS=y
BR2_TARGET_ROOTFS_SQUASHFS4_LZ4=y
# BR2_TARGET_ROOTFS_TAR is not set
BR2_TARGET_OPENSBI=y
# BR2_TARGET_OPENSBI_LATEST_VERSION is not set
# BR2_TARGET_OPENSBI_CUSTOM_VERSION is not set
# BR2_TARGET_OPENSBI_CUSTOM_TARBALL is not set
BR2_TARGET_OPENSBI_CUSTOM_GIT=y
BR2_TARGET_OPENSBI_CUSTOM_REPO_URL="https://github.com/hpmicro/opensbi.git"
BR2_TARGET_OPENSBI_CUSTOM_REPO_VERSION="2900da09af75c80ed8c4a8553a35e94e0f3f5c0d"
BR2_TARGET_OPENSBI_VERSION="2900da09af75c80ed8c4a8553a35e94e0f3f5c0d"
BR2_TARGET_OPENSBI_PLAT="hpmicro"
# BR2_TARGET_OPENSBI_INSTALL_DYNAMIC_IMG is not set
BR2_TARGET_OPENSBI_INSTALL_JUMP_IMG=y
# BR2_TARGET_OPENSBI_INSTALL_PAYLOAD_IMG is not set
# BR2_TARGET_OPENSBI_LINUX_PAYLOAD is not set
BR2_TARGET_OPENSBI_ADDITIONAL_VARIABLES="HPMSOC=HPM6800"
BR2_TARGET_HPMICRO_LOADER=y
BR2_TARGET_HPMICRO_BOARD_NAME="hpm6800evk"
BR2_PACKAGE_HOST_GENIMAGE=y
BR2_PACKAGE_HOST_MKPASSWD=y
```
